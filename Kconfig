## config/Kconfig.storage
```kconfig
# SPDX-License-Identifier: Apache-2.0 OR GPL-2.0-only
# SPDX-FileCopyrightText: 2026 Fernando Rodriguez
# config/Kconfig.storage — the block request layer (crates/drivers/block/src/queue.rs)
#
# The bounds of the per-hart submission queues that sit between the block
# facade (`blkdev`) and a device's hardware queue, and what the layer above
# may ask of a device: discard (TRIM) and force-unit-access. The devices driven
# through the queue: the native NVMe controller (DRV_NVME), the AHCI SATA host
# (DRV_AHCI), virtio-blk and a USB mass-storage disk (USB_STORAGE, which keeps
# a queue of its own). The io_ring's data entries ride the same queue
# (IORING_ASYNC).

menu "Storage"

config BLK_QUEUE_DEPTH
    int "Block requests queued per hart (2-64)"
    range 2 64
    default 4  if HWCLASS_EMBEDDED
    default 16
    help
      crates/drivers/block/src/queue.rs: every hart has its own submission
      queue of this many request slots. A request lives in a slot from its
      submit until its submitter has been told the outcome; the submitter
      sleeps for a free slot when its hart's queue is full. A transfer
      larger than one device command is cut into requests of at most one
      command, so a deeper queue lets one big write keep the device's
      queue full while the next requests merge behind it.

      Cost: NR_CPUS x BLK_QUEUE_DEPTH x about 100 B of RAM, in .bss,
      whether or not a device is bound to the queue. With USB_STORAGE the
      USB disk has a queue of the same size of its own, on the heap.

config BLK_MERGE_MAX
    int "Requests merged into one device command (1-16)"
    range 1 16
    default 4  if HWCLASS_EMBEDDED
    default 8
    help
      crates/drivers/block/src/queue.rs: requests of one owner, of the same
      operation, queued by any hart and adjacent on the medium, go to the
      device as ONE command, up to this many requests and up to the
      device's largest command. 1 turns merging off: every request is its
      own command (the pre-queue behaviour).

      Cost: 8 B per merged request for each command the device can hold at
      once, in .bss.

choice
    prompt "Discard (TRIM) of freed blocks"
    default BLK_DISCARD_OFF if HWCLASS_EMBEDDED
    default BLK_DISCARD_BATCHED
    help
      Whether the file systems and the swap area tell the device that
      blocks they freed hold nothing worth keeping (NVMe Dataset Management
      deallocate, virtio-blk VIRTIO_BLK_T_DISCARD), so a flash device can
      erase them ahead of the next write. Used by FAT32 (the chains freed
      when a file is truncated, replaced or removed) and the swap area (a
      segment brought back). A device without the command, and a board
      whose disk is not behind the block request layer (SD/eMMC), is
      never asked; the first refusal switches the file system's discard
      off until the next mount.

      A discard is never issued for a block the medium may still need:
      FAT32 discards a chain only after the write that stopped naming it is
      durable and before the FAT entries are freed, so a crash leaves a
      leaked chain, never a named file over erased blocks. The swap area
      keeps a slot reserved until its discard has completed.

    config BLK_DISCARD_OFF
        bool "off: never discard"

    config BLK_DISCARD_ONLINE
        bool "online: discard each freed chain on its own, before it is freed"

    config BLK_DISCARD_BATCHED
        bool "batched: gather what one flush frees, adjacent runs merged, and discard it together"

endchoice

config BLK_FUA
    bool "fsync commits with a force-unit-access write where the device has one"
    default y
    help
      crates/fs/fs/src/fat32.rs: a write-back pass ends its last run with
      PREFLUSH | FUA (every earlier write is made durable first, then this
      run is on stable media when it completes) and the explicit device flush
      that used to follow is skipped, one command fewer per fsync. Only on
      a device whose FUA is native (NVMe); virtio-blk has none and keeps the
      write-then-flush order, and so does a board whose disk is not behind
      the request layer. n: every fsync ends with an explicit flush.

      Cost: nothing in RAM. An fsync is still never implied by a write: the
      flush (or the FUA run) is made by the fsync, not by the writes before it.

config FS_DISCARD_RUNS
    int "Free runs gathered before FAT32 issues a discard (2-64)"
    range 2 64
    default 8 if HWCLASS_EMBEDDED
    default 16
    help
      crates/fs/fs/src/fat32.rs: the contiguous cluster runs of the chains
      one flush frees are collected up to this many (adjacent runs merge)
      and then discarded as one batch; a full batch is issued and a new one
      started. Batched mode only: online discards each chain's runs as they
      are found.

      Cost: FS_DISCARD_RUNS * 16 B of stack on the freeing path.

choice BLK_IOSCHED
    prompt "Block I/O scheduler"
    default BLK_IOSCHED_RT_DEADLINE
    help
      crates/drivers/block/src/queue.rs: in what order the request layer
      starts the requests queued on a device, and whether a slot of every
      hart's queue is kept for the requests that carry a durable record.

config BLK_IOSCHED_NONE
    bool "none: arrival order"
    help
      The oldest queued request is started first. A request's own deadline
      (BlockRequest::deadline_ns) still ends it with a miss when it passes
      before the request is started, but it no longer moves the request
      ahead of older ones. The cheapest pick: one comparison per queued
      request.

config BLK_IOSCHED_MQ_DEADLINE
    bool "mq-deadline: earliest deadline first"
    help
      The queued request with the earliest deadline is started first, then
      the oldest; a request without a deadline sorts after every request
      with one. Adjacent requests are merged behind the one picked, as with
      every scheduler.

config BLK_IOSCHED_RT_DEADLINE
    bool "rt-deadline: mq-deadline plus a reserved real-time request slot"
    help
      As mq-deadline, and a request of the real-time class is started before
      every other. Every hart keeps ONE slot of its queue for that class: an
      ordinary request is refused (try_submit) or put to sleep (submit) when
      the queue has one free slot left, so a durable record's write never
      waits for a free slot behind bulk traffic.

      The class belongs to the REQUEST, not to the task that issues it. A
      request is of the real-time class when it serves a durable record that
      waits for the medium (the flight recorder's e-stop latch, the
      operator-release nonce floor, a decision refusal: everything pushed
      through push_durable): the writes and the fsync of the flush that
      carries the record, whichever task or Domain's context runs it, and
      the write-back passes of the FAT32 cache its lines go through (the
      fs-wb task, or a task that runs a pass meanwhile). The same task's
      requests are ordinary again once the record is on the medium. A task
      in the real-time band still never does block I/O (RT_BLOCK_IO_CHECK):
      its record reaches the ring and the log flusher writes it.

      Needs BLK_QUEUE_DEPTH of at least 2 (always true: the range starts at
      2). Cost: one of BLK_QUEUE_DEPTH slots per hart is not available to
      ordinary requests.

endchoice

config IORING_ASYNC
    bool "io_ring data entries are queued: no file or block work in a submit"
    depends on IORING_WORKER
    default y
    help
      crates/core/ipc/src/io_ring.rs, crates/core/syscall/src/ioring_ops.rs.
      Owner rule: an io_ring submit (and an SQ poller pass) only enqueues.
      y: an OP_BLOCK_WRITE and an OP_BLOCK_READ become a request of the block request layer (BLK_QUEUE_DEPTH slots,
      merged with its neighbours) and PARKS on the ring; the submit starts no
      device command and sleeps for nothing. The io_ring worker starts the
      queue, sleeps until the oldest request is over and posts the
      completion through the CQ (and the ring's port): a read is CQE result
      = bytes, a write is the same with CQE_F_QUEUED (completed by the
      device with no flush behind it, not yet durable: an OP_FSYNC on the
      mounted volume ends in a device flush, which covers it). A file entry
      (OP_FILE_READ,
      OP_FILE_WRITE) of EVERY submitter goes to the worker, which runs it
      in SQ order and completes it later (a write CQE_F_QUEUED, into the
      write-back cache): the file seam is synchronous, so the worker is
      its queue. A network send already queues on the socket and the NIC
      ring and never waits; it is unchanged. A block READ of sectors the
      FAT32 write-back cache (FS_WRITEBACK) holds unwritten is not queued by
      a submit: writing them out first waits for the device, so the submit
      only asks the cache (a probe under its leaf lock) and hands the entry to
      the worker, which writes them back and then reads. A block entry the
      layer cannot take (a board whose disk is not behind it, a full queue, a
      run longer than one device command, no free parked slot) takes the
      synchronous path in a task that may block and the worker's otherwise.
      n: a task that may block runs its file and block entries inline in
      the submit, as before; only a real-time submitter hands off.

      Measured before this option existed (K1 ktest, riscv64 with a disk,
      -icount shift=0, 31 FAT32 writes + 1 fsync from a normal-priority task,
      one run each, virtual ns): inline submit 10.2 M, fsync durable 17.8 M
      after the submit began; hand-off submit 3 k, durable 19.7 M. The
      hand-off frees the submitter but is ~10% slower end to end.

      A queued block entry counts against IORING_MAX_PARKED and holds a
      completion slot of the CQ until it completes, like a timer or an fsync.
      A ring destroyed with one parked leaves the request to the worker, which
      collects it. A write's data is copied at the submit and a read's lands
      in the ring when the completion is posted: the device never sees the
      ring page.

      Cost: a bounce buffer on the heap per queued request (its length, at
      most RING_DATA_BUF_SIZE bytes) and 64 B of .data per request the block
      layer can hold (NR_CPUS x BLK_QUEUE_DEPTH, at most
      MAX_IO_RINGS x IORING_MAX_PARKED: 8 KiB at the defaults); a wake-up and
      a context switch of the worker per batch. A real-time submitter's block
      entry allocates its bounce buffer and takes the hart queue's spinlock
      (a read also the write-back cache's) in its own submit; it never sleeps.

endmenu # Storage
```
