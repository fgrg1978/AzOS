## config/Kconfig.audio
```kconfig
# SPDX-License-Identifier: Apache-2.0 OR GPL-2.0-only
# SPDX-FileCopyrightText: 2026 Fernando Rodriguez
# config/Kconfig.audio — The audio server's policy
#
# The interface (crates/core/devif/src/sound.rs, `Sound`) fixes what a stream
# may name: its bounds are constants of that file. The options here are what a
# build lets the audio server (AUDIOD.ELF, userspace/services/audiod) accept
# inside them, so every range
# stops at the interface's bound (tests/host/devif-tests/tests/sound.rs keeps
# the two equal). The devices themselves are `[audio.NAME]` rows of the signed
# topology (TOPOLOGY_MAX_AUDIO in config/Kconfig.security); which hardware
# serves a row is the driver tables' business, not this menu's.

menu "Audio"

config AUDIOD
    bool "Audio server (AUDIOD.ELF): mixes the clients' streams into the one device stream"
    depends on DRV_VIRTIO_SND
    default y if !HWCLASS_EMBEDDED && !USE_ROBOT && !USE_INDUSTRIAL
    default n
    help
      The built-in topology carries a row for AUDIOD.ELF and the kernel starts
      it at boot. The server serves the `Sound` interface on `endpoint.audio`
      (userspace/services/audiod): a client opens a stream, hands it periods of
      memory it made, and the server mixes the streams (a saturating sum, a
      per-stream gain, the device's rate and format, one stream's underrun its
      own) into the one playback stream it holds on the kernel's `sound.0`.
      Capture is not mixed: the client's own objects are handed to the kernel's
      microphone gate, which needs the `mic` effect of the CLIENT's class (the
      server holds none) and records every attempt that reaches it, naming the
      client (AUDIO_CAPTURE). `toolbox beep` goes through the server when its row
      holds `endpoint.audio` and straight to `sound.0` otherwise; with the
      server, the toolbox row holds no `sound.0` (the device has one holder).

      The row is a deadline reservation of 1 ms every 10 ms (10 % of a CPU,
      `hard_rt`, priority 12) that keeps the device fed under load. A robot or
      industrial image has no speaker to share and is n; a small board is n
      (native drivers only: it has no virtio-sound).

      Cost when set: one task of AUDIOD_MEM_PAGES pages (the topology
      builder), two threads (16 KiB stack for the pump), 48 KiB of static
      state, and 3 + 3 memory objects open at a time per stream.


config AUDIO_CAPTURE
    bool "Audio server: capture streams (the microphone)"
    default y if !HWCLASS_EMBEDDED
    default n
    help
      y: the audio server opens `DIR_CAPTURE` streams. The kernel's gate
      admits each one on the `mic` effect of the REQUESTER's scheduler class
      (an `[envelope.NAME]` row with `kind = "mic"`): the client that made the
      call the server is serving, which the server names to the kernel by the
      call's warrant (`Sound::open`'s `on_behalf`). The server's own class is
      never consulted and the `audio-capture` decision record names the
      client, so holding `endpoint.audio` is not holding the microphone: only
      a client whose class has the effect listens, and one without it is
      refused with a durable record naming it. A task that calls `sound.0`
      itself is its own requester.
      n: the capture path is not compiled; a capture `open` answers
      UNSUPPORTED and no envelope row can enable it. An image that must never
      listen is built with n, which no topology can undo.

      Small boards name it: a HWCLASS_EMBEDDED build is n unless the config
      says y.

      Cost: no static RAM. The code of the capture path, not measured.

config AUDIO_MAX_STREAMS
    int "Audio server: streams open at once"
    range 1 32
    default 2 if PROFILE_EMBEDDED
    default 8
    help
      Streams (open `Sound` capabilities, playback and capture together) the
      audio server holds. The next `open` answers BUSY. Each stream is one
      slot of the server's static table; a device that mixes several
      clients' streams into one hardware stream uses one slot per client.

      Cost: one table slot per stream (AUDIOD's stream record, 160 bytes),
      not measured on a board.

config AUDIO_MAX_PERIODS
    int "Audio server: most periods in one stream's arena"
    range 2 64
    default 8 if PROFILE_EMBEDDED
    default 32
    help
      The most periods a client may name in `Params::periods`; more is
      BAD_ARGUMENT. The interface's own bound is 64 (`PERIODS_MAX`, one bit a
      period in `Posted`). Latency is `periods * period_frames / rate`: a
      stream that wants a small delay uses few short periods, and the bound
      keeps one client from holding the server's queues for seconds.

      Cost: none by itself; each period is client memory (the arena), and the
      two queues of a stream are `SpscSlots<4>` of the next power of two above
      the periods (one slot is the drain end marker; 256 B header + 32 B a slot, in the client's memory
      objects).

config AUDIO_ARENA_KB_MAX
    int "Audio server: largest arena of one stream (KiB)"
    range 4 16384
    default 64 if PROFILE_EMBEDDED
    default 4096
    help
      The most memory a client may hand the server as one stream's arena
      (`periods * period_frames * channels * sample bytes`); a bigger geometry
      is BAD_ARGUMENT. The interface's own bound is 16 MiB
      (`ARENA_BYTES_MAX`). The arena is the client's memory, mapped by the
      server for the stream's life, so the bound caps what a client can pin
      in the server's address space, not what the kernel allocates.

      Cost: no static RAM.

endmenu
```

## config/Kconfig.brain
```kconfig
# SPDX-License-Identifier: Apache-2.0 OR GPL-2.0-only
# SPDX-FileCopyrightText: 2026 Fernando Rodriguez
# config/Kconfig.brain — Brain server link defaults and subsumption layer enables
#
# RFC-0026 Phase C1.  Compile-time defaults for the brain link.
# Runtime values can be overridden in CONFIG.INI.
#
# Sourced from inside the Robot menu (config/Kconfig.robot), so it is shown
# only for DOMAIN_ROBOT. The brain-link task is compiled only into a
# DOMAIN_ROBOT image (kernel feature `domain-robot`, wave 11); its two
# enforcement switches in "Security" depend on DOMAIN_ROBOT.

menu "Brain Server Link"
config MULTISTREAM_SCHED_PRIORITY
    bool "Multi-stream scheduler: priority (control preempts bulk)"
    default n
    help
      RFC-0021 multi-stream link scheduling policy — a compile-time
      choice so each binary carries exactly one policy (zero hot-path
      overhead; the unused branch is const-eliminated).

      n (default) = FIFO: streams share the link in send order; a large
        STREAM_CAMERA frame can head-of-line-block a STREAM_CONTROL frame.
      y = PRIORITY: STREAM_CONTROL frames are interleaved ahead of bulk
        stream chunks, bounding control hold-off to ~one chunk-time
        instead of one full bulk-frame-time (experiment I2).

      Selected via `make menuconfig` / defconfig; surfaces as
      `azos_limits::MULTISTREAM_SCHED_PRIORITY`. A/B the two builds
      with the bench_boot capture + dashboard. Outside DOMAIN_ROBOT the
      option is hidden and reads as n (FIFO).

config BRAIN_TX_QUEUE_BYTES
    int "Brain link: control-socket transmit queue (bytes)"
    range 4096 262144
    default 12288 if PROFILE_EMBEDDED
    default 32768 if PROFILE_FLEET
    default 16384
    help
      Wave 15 (IO-QUEUES-AUDIT B1). The behavior task seals each message
      for the brain into this queue and returns; the `brain-tx` task
      (BRAIN_TX_PRIORITY) puts it on the socket, waiting for the TCP window
      there and not in the subsumption loop. One FIFO of sealed wire bytes
      (RFC-0019 records cannot be dropped or reordered once sealed).

      Costs this many bytes of .bss. A camera frame sent on the control
      connection (no `behavior_camera_port`) is about 8.5 KiB and is only
      admitted with that much room above BRAIN_TX_CONTROL_RESERVE_BYTES;
      below ~10 KiB the control connection carries no camera frames.
      Raise it for a slow or lossy link where telemetry frames are dropped
      (the `[BRAIN-TX]` counters), lower it on a RAM-tight board that sends
      no camera frames on this connection.

config BRAIN_TX_CONTROL_RESERVE_BYTES
    int "Brain link: queue bytes only control messages may use"
    range 256 65536
    default 1024
    help
      Telemetry (sensor and camera frames) is admitted only while this much
      of BRAIN_TX_QUEUE_BYTES stays free, so control messages (the status
      packet, an RFC-0019 REJECT) are never refused because telemetry
      filled the queue. A refused telemetry frame is dropped before it is
      sealed and counted. No RAM of its own. Raise it if control messages
      grow beyond ~1 KiB sealed.

config BRAIN_TX_PRIORITY
    int "Brain link: priority of the brain-tx sender task"
    range 12 30
    default 15
    help
      The task that dials the brain for the behavior task (DHCP, connect,
      the RFC-0019 handshake) and drains BRAIN_TX_QUEUE_BYTES to the
      socket. Below the behavior task (14) on the same hart, so a send or a
      dial never delays the subsumption loop; above the default priority
      (16) so the queue does not wait behind background work. Not in the
      RT band (12 and below): it waits on the network.

config BRAIN_TX_IDLE_PARK_MS
    int "Brain link: brain-tx park with an empty queue (ms)"
    range 10 10000
    default 100
    help
      How long the sender sleeps when nothing is queued. The behavior task
      wakes it at the end of each tick that queued bytes, so this only
      bounds the delay of a lost wake. One timer wake per period.

config BRAIN_TX_STALL_MS
    int "Brain link: end the session after the socket takes nothing (ms)"
    range 1100 60000
    default 2000
    help
      Queued bytes the socket has taken none of for this long end the
      session (fail closed); the next tick dials a fresh handshake. Above
      one TCP retransmission timeout (1000 ms) so one lost segment does not
      end a healthy session; below the brain's shortest comms timeout
      (3 s, drone) so the brain does not declare the link lost first.

config BRAIN_SEND_BUDGET_US
    int "Brain link: longest blocking send (us)"
    range 10000 5000000
    default 500000
    help
      Bound of the blocking sends left outside the queue: the RFC-0019
      handshake's frames (HELLO reply, REJECT), sent by the brain-tx task
      while it dials (the behavior task never waits for them). The order of
      the motor watchdog (500 ms without a command SAFE-STOPs).

config BRAIN_NET_WAIT_POLL_MS
    int "Brain link: network wait poll period (ms)"
    range 1 100
    default 1
    help
      The sleep between polls of a brain-link network wait (handshake
      frames, ARP, the sender's closed TCP window). Shorter: lower latency
      after the event, more timer wakes (one per period while waiting).

endmenu # Brain Server Link
```
