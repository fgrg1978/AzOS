## config/Kconfig.preset
```kconfig
# SPDX-License-Identifier: Apache-2.0 OR GPL-2.0-only
# SPDX-FileCopyrightText: 2026 Fernando Rodriguez
# config/Kconfig.preset — The profile axes and the presets (owner decision D1)
#
# Seven axes describe what an image is:
#   HWCLASS    the hardware class            (this file)
#   USE        what the image is for         (config/Kconfig.use, USE_*; derived 1:1 from the
#                                             preset, not a choice)
#   STRUCTURE  where the drivers run         (this file)
#   RT         the real-time class           (this file)
#   SECURITY   the security posture          (this file)
#   BUILD_TYPE dev / release / certifiable   (config/Kconfig.development)
#   VIRT       the hypervisor role           (this file)
# and one choice, PRESET, sets all of them at once. A defconfig is one PRESET
# line plus its board lines (ISA, board, RAM, the HWCLASS the board is).
#
# A preset works only through `default ... if PRESET_*` on the axes and
# through the axes' own `default`/`imply` lines on the options they own; it
# never `select`s. Every axis can be changed by hand after the preset, and a
# value set by hand wins. A hard incompatibility is a `depends on`.
#
# USE is what was called the application domain: it has no menu of its own and is
# set by the PRESET alone (a defconfig names the preset, never a USE_* symbol).
# Its symbols are USE_* (the cargo feature `use-robot`, the generated
# constants and the robot menus are named after it). "Domain" now names only the isolation object.

menu "Preset and profile axes"

choice
    prompt "Preset"
    default PRESET_GENERIC
    help
      One choice that sets every axis below (and, through them, the options
      the axes own) to the values the preset needs. Choose the closest
      preset first, then change an axis or an option by hand where the
      product differs: a value set by hand wins over the preset's. The
      board lines of a defconfig (ISA, board, RAM size, HWCLASS) are not
      the preset's: a robot on a 64 MiB board is PRESET_ROBOT with
      HWCLASS_EMBEDDED.

      The presets do not set BUILD_TYPE: a QEMU image is a development
      build and a board image a release build whatever the preset is.
      `make check-presets` expands every preset on every ISA.

    config PRESET_GENERIC
        bool "General: Generic (QEMU, development, evaluation)"
        help
          A general-purpose kernel: USE generic, RT none, hybrid structure,
          general security. The old edge/embedded/fleet defconfigs.

    config PRESET_ROBOT
        bool "Embedded control: Robot (mobile robots, drones, robotic arms)"
        depends on CAP_SLOT_EXT
        help
          USE robot (the robot crates and tasks are linked), RT hard. The
          durable refusal receipt (DECISION_REFUSALS_DURABLE) is on in
          every preset. Write-ahead receipts for ring-3 motor ops
          (EFFECT_WRITE_AHEAD) are on in this preset, because USE is robot;
          no other preset links the robot crates.
          Needs CAP_SLOT_EXT: the behavior loop reaches the ring-3 inference
          service through a badged endpoint capability, which a one-word
          capability slot cannot hold, so without it every cycle would end
          unavailable and the loop would stay at STOP for good.

    config PRESET_INDUSTRIAL
        bool "Embedded control: Industrial (PLC, CNC, motion control)"
        help
          USE industrial, RT hard, SECURITY separation-static, VIRT static,
          memory committed at map time (no demand paging).

    config PRESET_AUTOMOTIVE
        bool "Embedded control: Automotive (ECU, ADAS, telematics)"
        help
          As industrial, USE automotive.

    config PRESET_FIRMWARE
        bool "Embedded control: Firmware (BMC, storage or power controllers)"
        help
          USE firmware on HWCLASS embedded, RT soft, hardened.

    config PRESET_IOT_HMI
        bool "Connected devices: IoT / HMI (smart panels, kiosks, appliances)"
        help
          USE iot-hmi (display, touch, battery), RT soft, hardened.

    config PRESET_WEARABLE
        bool "Connected devices: Wearable (smartwatch, fitness band)"
        help
          USE wearable on HWCLASS embedded, RT soft, hardened.

    config PRESET_GATEWAY
        bool "Connected devices: Gateway (edge router, protocol bridge)"
        help
          USE gateway (the larger network tables), RT soft, hardened.

    config PRESET_DESKTOP
        bool "Computers: Desktop (workstation, laptop, mini-PC)"
        help
          USE desktop on HWCLASS desktop, RT soft, hardened, demand paging;
          VIRT hosted on x86_64 and split on aarch64.

    config PRESET_SERVER
        bool "Computers: Server (rack server, cloud node, NAS)"
        help
          USE server on HWCLASS server (the Fleet cap tables), RT none,
          hardened; VIRT hosted on x86_64 and split on aarch64.

endchoice

# ---------------------------------------------------------------------------
# HWCLASS
# ---------------------------------------------------------------------------

choice
    prompt "Hardware class (HWCLASS)"
    default HWCLASS_EMBEDDED if PRESET_FIRMWARE || PRESET_WEARABLE
    default HWCLASS_DESKTOP if PRESET_DESKTOP
    default HWCLASS_SERVER if PRESET_SERVER
    default HWCLASS_SBC
    help
      The class of machine the image runs on. It picks the resource-limit
      tier (config/Kconfig.limits): embedded the smallest tables,
      sbc and desktop the Edge tables, server the Fleet tables. Each limit
      can still be set by hand under "Resource Limits".

    config HWCLASS_EMBEDDED
        bool "Embedded (small boards, 16-64 MiB of RAM)"
        help
          Small boards running one device's workload, linked into the 14 MiB
          above the firmware (kernel/linker-embedded.ld). The smallest tables.

    config HWCLASS_SBC
        bool "Single-board computer (VF2, K1, Raspberry Pi 5, RK3588)"
        help
          1-8 GiB of RAM: the Edge tables, sized for about 200 userspace
          apps, 100 sensor streams and one upstream link.

    config HWCLASS_DESKTOP
        bool "Desktop / workstation"
        help
          The Edge tables until the desktop tier has its own.

    config HWCLASS_SERVER
        bool "Server / gateway machine"
        help
          Many devices aggregated: the Fleet tables (a 135 MiB static image
          and a 256 MiB kernel heap).

endchoice

# The cap-size tier the limits are written against, derived from HWCLASS.
config PROFILE_EMBEDDED
    def_bool HWCLASS_EMBEDDED

config PROFILE_FLEET
    def_bool HWCLASS_SERVER

config PROFILE_EDGE
    def_bool !PROFILE_EMBEDDED && !PROFILE_FLEET

# ---------------------------------------------------------------------------
# STRUCTURE
# ---------------------------------------------------------------------------

choice
    prompt "Structure (STRUCTURE)"
    default STRUCTURE_HYBRID
    help
      Where the drivers run.

    config STRUCTURE_HYBRID
        bool "Hybrid (each driver in the kernel or ring 3, as its own choice says)"
        help
          Every driver starts where its own placement choice
          (DRV_<NAME>_PLACEMENT) says.

    config STRUCTURE_RING3_DRIVERS
        bool "Drivers as ring-3 servers"
        imply DRV_RING3_DEFAULT
        help
          Drivers run as ring-3 server processes. Implies DRV_RING3_DEFAULT
          (under "Drivers"), which starts every per-driver placement choice
          at `ring3`; each can be changed by hand. Drivers a safety decision
          reads have no placement choice and stay in the kernel (the closed
          list is in config/Kconfig.drivers). The ring-3 drivers are started
          from their topology rows (by the component manager) on BOARD_QEMU
          only.

endchoice

# ---------------------------------------------------------------------------
# RT
# ---------------------------------------------------------------------------

choice
    prompt "Real-time class (RT)"
    default RT_HARD if PRESET_ROBOT || PRESET_INDUSTRIAL || PRESET_AUTOMOTIVE
    default RT_SOFT if PRESET_IOT_HMI || PRESET_GATEWAY || PRESET_DESKTOP || \
                       PRESET_FIRMWARE || PRESET_WEARABLE
    default RT_NONE
    help
      What the image promises about time. The real-time band
      (SCHED_CLASS_RT) is in every image, because the shared actuation
      authority runs in it; this axis says whether the image's own tasks
      depend on it.

    config RT_NONE
        bool "None"
        help
          No task of the image has a deadline.

    config RT_SOFT
        bool "Soft"
        depends on SCHED_CLASS_RT
        help
          Deadlines whose misses degrade a service (audio, display,
          haptics, sensor reads).

    config RT_HARD
        bool "Hard"
        depends on SCHED_CLASS_RT
        depends on MM_PRECOMMIT_RT || !MM_DEMAND_PAGING
        help
          Deadlines whose misses are faults (a motor loop, a control loop).
          A hard task must never take a demand fault: mmap commits at map
          time for it (MM_PRECOMMIT_RT), or for everyone (no demand paging).

    config RT_MIXED
        bool "Mixed (a hard cluster beside a general cluster)"
        depends on SCHED_CLASS_RT
        depends on MM_PRECOMMIT_RT || !MM_DEMAND_PAGING
        help
          Hard deadlines on a few harts kept apart, and a general-purpose
          workload on the others.

endchoice

# ---------------------------------------------------------------------------
# SECURITY
# ---------------------------------------------------------------------------

choice
    prompt "Security posture (SECURITY)"
    default SECURITY_SEPARATION_STATIC if PRESET_INDUSTRIAL || PRESET_AUTOMOTIVE
    default SECURITY_HARDENED if PRESET_IOT_HMI || PRESET_GATEWAY || PRESET_DESKTOP || \
                                 PRESET_SERVER || PRESET_FIRMWARE || PRESET_WEARABLE
    default SECURITY_GENERAL
    help
      How much the image trusts what runs on it. It sets the default of
      OTA_SIG_MANDATORY, of the threat model ("Mitigations") and, for
      Hardened, of KASLR (require); every switch it sets can be changed by
      hand.

    config SECURITY_GENERAL
        bool "General"
        help
          The base threat model (a compromised ring-3 image). No default
          beyond the switches' own.

    config SECURITY_HARDENED
        bool "Hardened"
        help
          Third-party code runs in ring 3. Unsigned OTA images are refused
          (OTA_SIG_MANDATORY starts on) and the kernel image must be slid at
          boot (KASLR starts at require: an image without a seed does not
          boot).

    config SECURITY_SEPARATION_STATIC
        bool "Separation, static"
        help
          The device can be touched and its partitions are fixed at build
          time. Unsigned OTA images are refused, and the threat model is
          "Physical access to the device".

    config SECURITY_CONFIDENTIAL
        bool "Confidential"
        help
          As separation-static, for workloads kept apart from the host:
          VIRT starts at `split`.

endchoice

# ---------------------------------------------------------------------------
# VIRT
# ---------------------------------------------------------------------------

choice
    prompt "Virtualization role (VIRT)"
    default VIRT_SPLIT if SECURITY_CONFIDENTIAL
    default VIRT_STATIC if PRESET_INDUSTRIAL || PRESET_AUTOMOTIVE
    default VIRT_HOSTED if (PRESET_DESKTOP || PRESET_SERVER) && ARCH_X86_64
    default VIRT_SPLIT if (PRESET_DESKTOP || PRESET_SERVER) && ARCH_AARCH64
    default VIRT_NONE
    help
      The hypervisor role of the image. Anything but `none` builds the
      hypervisor core (config/Kconfig.hv, crates/core/hv): the topology's
      `[guest.NAME]` rows are admitted at boot and each becomes a VM with a
      `vm.<n>` endpoint. The CPU's extension is probed per ISA (RV_H,
      X86_SVM, X86_VMX; EL2 on aarch64) and a CPU without it runs the role as
      `none`, with the reason in the boot line, unless HV_REQUIRE says the
      image is useless without it. What the role may not be combined with is
      a `depends on`. Booting a guest image is a later step.

    config VIRT_NONE
        bool "None"
        help
          The kernel runs on the hardware and hosts no guest.

    config VIRT_HOSTED
        bool "Hosted (guests run beside the kernel)"
        depends on !BOARD_VF2
        help
          The kernel hosts guests with the CPU's virtualization extension
          and keeps its own drivers.

    config VIRT_SPLIT
        bool "Split (a resident monitor under the kernel)"
        depends on !BOARD_VF2
        help
          A small resident monitor owns the virtualization extension and the
          kernel runs as its first guest (the aarch64 EL2 stub shape).

    config VIRT_STATIC
        bool "Static partitioning (pinned guests, fixed at build time)"
        depends on !BOARD_VF2
        help
          Guests are pinned to harts and memory fixed in the signed
          topology; no guest is created at run time.

endchoice

endmenu # Preset and profile axes
```
