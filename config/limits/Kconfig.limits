## config/subsys/Kconfig.keystore
```kconfig
# SPDX-License-Identifier: Apache-2.0 OR GPL-2.0-only
# SPDX-FileCopyrightText: 2026 Fernando Rodriguez
# config/subsys/Kconfig.keystore — The keystore

# ---------------------------------------------------------------------------
# Keystore (azos_crypto::keystore, the kernel-hosted `keys` interface)
# ---------------------------------------------------------------------------
#
# Keys held for their users: a task holds a handle and asks the kernel to
# sign, seal or derive with it (`azos_devif::keys`, `azos_syscall::keys`). The
# table is a fixed array in .bss; the roots persistent keys derive from are
# the board seed (BOOTMETA's reserved sector, always), a secret in a TPM NV
# index, and a secret in a file on a sealed volume.

config KEYSTORE_KEYS
    int "Keystore: key handles the kernel holds"
    range 4 255
    default 16 if HWCLASS_EMBEDDED
    default 64 if HWCLASS_SERVER
    default 32
    help
      Live handles in all owners' tables together (a handle names its slot
      in 8 bits, so at most 255). A slot is about 130 bytes of .bss. A
      handle that expired or was destroyed gives its slot back; a task that
      exits does not destroy the keys of its owner, so a service that opens
      the same named key again gets the same handle and a service that
      makes volatile keys destroys them or gives them a time to live.

config KEYSTORE_KEYS_PER_OWNER
    int "Keystore: handles one owner may hold"
    range 1 255
    default 4 if HWCLASS_EMBEDDED
    default 8
    help
      One owner (a user, `owner_root`; 0 is the system) cannot fill the
      table: past this share a new key is refused with BUSY. At most
      KEYSTORE_KEYS.

config KEYSTORE_TPM_NV
    bool "Keystore: a secret in a TPM NV index as a root (backend tpm_nv)"
    depends on TPM
    default y
    help
      The boot reads a 32-byte secret from an NV index of the TPM (defined
      and filled from the entropy pool the first time), and keys opened
      with the tpm_nv backend are derived from it: they exist only on a
      board with this TPM, and the volume holds nothing to copy. The index
      has the OTA floor's shape and the same password rule (a password the
      kernel derives, so it is as safe as that password is secret; a policy
      bound to PCRs is the next step). With no TPM, or one that fails, the
      backend answers NOT_READY and the boot says so.

config KEYSTORE_VOLUME_ROOT_PATH
    string "Keystore: file holding the secret of the volume backend"
    default ""
    help
      The path of a 32-byte file, on a volume the kernel mounts, that keys
      opened with the volume backend derive from; empty: no volume backend
      (it answers NOT_READY). The file is created from the entropy pool at
      the first boot that can write it, after the mounts. Put it under the
      mount point of an `aead = true` [volume.NAME] row (azvol, sealed under
      the board's seed), so that the secret is ciphertext on the medium and
      a volume cloned to another board does not open; on a plain FAT32
      volume it is readable by whoever can read the medium.
```
