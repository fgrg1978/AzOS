## config/kernel/Kconfig.lockdep
```kconfig
# SPDX-License-Identifier: Apache-2.0 OR GPL-2.0-only
# SPDX-FileCopyrightText: 2026 Fernando Rodriguez
# config/kernel/Kconfig.lockdep — The lock dependency checker

# ---------------------------------------------------------------------------
# Lock dependency checker, lockdep-lite (N1)
# ---------------------------------------------------------------------------

choice
    prompt "Lock dependency checker (lockdep-lite)"
    default LOCKDEP_KTEST if BUILD_TYPE_DEV
    default LOCKDEP_N
    help
      crates/core/sync/src/lockdep.rs. A lock's class is the place its
      constructor is called (`SpinLock::new`, `Mutex::new`,
      `Claim::new`, `WaitQueue::new`: the declaration site, through
      `#[track_caller]`, no call site changes). Every acquisition checks
      the calling CPU's held-lock stack against a global table of "A was
      held when B was taken" edges and reports, once each:
        * an inversion (B taken under A after A was taken under B: ABBA);
        * a lock taken again by its holder;
        * a sleep or a device wait (`might_sleep`: WaitQueue waits, Mutex
          acquisition, the block layer and the virtio-blk
          wait) while a SpinLock is held, with IRQs off or in an interrupt;
        * a lock still held on a return to user mode (the riscv64, aarch64
          and x86_64 trap paths), and a task exiting with one.
      Reports are queued and printed by the ktest runner; any of them turns
      the running test (or the run) red. Printed but failing nothing
      (notes): two locks of one class nested, and a Mutex held across a
      device wait (owner rule F1).

config LOCKDEP_N
    bool "Off"
    help
      Not compiled: no field in any lock, no instruction on any path.

config LOCKDEP_KTEST
    bool "In ktest kernels"
    depends on BUILD_TYPE_DEV
    help
      On in kernels built with KTEST (the gate's `ktest` rows) only; every
      other kernel is as with Off. The default in development builds.
      Costs, in those kernels: 16 bytes in a SpinLock (its class key and
      declaration site) and 20 in a Mutex (also its
      holder's CPU and RT-ness), the tables below, and per acquisition, with
      interrupts briefly off, a hash of the held chain plus, for a chain
      not seen before, one table probe per held lock.

config LOCKDEP_Y
    # cargo-feature: lockdep
    bool "In every development kernel"
    depends on BUILD_TYPE_DEV
    help
      Compiled into every kernel of this configuration (the kernel cargo
      feature `lockdep`), at the cost stated under "In ktest kernels".
      Outside a ktest run the `log-flush` task prints the reports (never a
      lock path), with the counters and the longest holds.

endchoice

config LOCKDEP_MAX_DEPTH
    int "Lockdep: locks one context may hold at once"
    range 4 64
    default 20
    help
      Entries in each CPU's held-lock stack and in each task's copy of it
      (saved at a context switch). 20 is Linux's MAX_LOCK_DEPTH, the bound
      its proof argument assumes; AzOS paths hold a handful. A deeper
      nesting is reported (a violation) and the extra locks not tracked.
      48 bytes per entry per CPU (NR_CPUS) and per task (MAX_TASKS) when
      lockdep is compiled in; nothing otherwise. Same on every ISA and
      profile.

config LOCKDEP_EDGES
    int "Lockdep: dependency edges kept (table size)"
    range 256 65536
    default 2048 if HWCLASS_EMBEDDED
    default 8192 if HWCLASS_SERVER
    default 4096
    help
      Slots of the lock-free open-addressed table of "A held, B taken"
      class pairs: 24 bytes each when lockdep is compiled in. A full table
      is a violation (the checker stopped seeing new orders): raise it,
      never ignore it. A QEMU ktest kernel records a few hundred edges.

config LOCKDEP_CHAINS
    int "Lockdep: lock chains cached as already checked (table size)"
    range 256 65536
    default 2048 if HWCLASS_EMBEDDED
    default 8192 if HWCLASS_SERVER
    default 4096
    help
      Slots of the chain-hash cache: a hash of the held classes plus the
      one being taken, so each distinct chain is walked against the edge
      table once (Linux's chain-key cache); it also remembers the reported
      violations so each is reported once. 8 bytes per slot when lockdep
      is compiled in. A full cache costs time (every acquisition rechecks
      its chain) and may report a violation twice, never miss one.

config LOCKDEP_REPORTS
    int "Lockdep: violation reports queued for printing"
    range 1 256
    default 64
    help
      Distinct violations kept, with both classes and acquisition sites,
      until the ktest runner prints them (never printed from inside a lock
      path: the console takes locks). Later ones are counted and fail the
      run but are not described. About 150 bytes each when compiled in.

config LOCK_MAX_HOLD_US
    int "Longest a SpinLock may be held (us): the IRQs-off bound"
    range 1 100000
    default 50 if HWCLASS_EMBEDDED
    default 200 if HWCLASS_SERVER
    default 100
    help
      The owner's "never an unbounded IRQs-off spin" as a number: the
      longest a SpinLock (the RawSpinLock role: preemption off, and with
      `lock_irqsave` interrupts off) may be held. Lockdep times every hold
      (per-class histogram, printed with the ktest summary) and reports a
      SpinLock held longer, as a violation with LOCKDEP_HOLD_ENFORCE and as
      a note without it. No cost of its own: a constant. Lower it for a
      tighter interrupt-latency budget.

config LOCKDEP_HOLD_ENFORCE
    bool "Lockdep: a SpinLock held past LOCK_MAX_HOLD_US fails the run"
    default n if BUILD_TYPE_DEV
    default y
    help
      With lockdep compiled in, a SpinLock hold longer than
      LOCK_MAX_HOLD_US is a violation (the ktest runner fails the test
      that was running). Off, the same hold is printed as a note and
      fails nothing; the histogram is kept either way. Hold times are the
      platform timer's ticks: on the QEMU board (TCG without -icount, the
      gate's ktest rows) they are host wall time, tens of times a
      hardware board's and inflated whenever the host deschedules a vCPU,
      so the default is off in a development build (BUILD_TYPE_DEV: the
      QEMU defconfigs; the build type, not the board, keys it) and the
      notes are the list to triage.
      The gate's `ktest hold bound, -icount` rows turn it on for QEMU and
      boot one vCPU under `-icount shift=0`, where the timer is virtual
      time and 1 us = 1,000 guest instructions: the bound in instructions.
      On by default in a release build; the vf2 ktest image (a development
      build on hardware, `make vf2 BUILD_TYPE=DEV VF2_TEST=ktest`) turns it
      on by name (mk/kernel.mk VF2_EXTRA_ktest). No cost: a constant.

config LOCKDEP_CLASSES
    int "Lockdep: lock classes tracked per class (table size)"
    range 64 16384
    default 256 if HWCLASS_EMBEDDED
    default 1024 if HWCLASS_SERVER
    default 512
    help
      Slots of the per-class table that holds what is known about each
      lock class: where it was taken in interrupt context and where with
      interrupts on (the IRQ-safety inference), its longest hold and its
      hold histogram. 64 + 4 x LOCKDEP_HOLD_BUCKETS bytes per slot when
      lockdep is compiled in. A class that finds the table full is not
      inferred or timed, and the summary counts it: raise this then.

config LOCKDEP_HOLD_BUCKETS
    int "Lockdep: hold-time histogram buckets per class"
    range 4 32
    default 16
    help
      Power-of-two microsecond buckets of each class's hold histogram
      (bucket k counts holds below 2^k us; the last takes the rest). 16
      reaches 32 ms. 4 bytes per bucket per LOCKDEP_CLASSES slot.

config LOCKDEP_HOLD_TOP
    int "Lockdep: classes the summary prints by longest hold"
    range 0 64
    default 8
    help
      The ktest summary (and LOCKDEP=y's log) prints this many classes,
      longest maximum hold first, each with its declaration site, hold
      count and histogram. Printing only; no cost on a lock path.

config LOCKDEP_IRQ_INFERENCE
    bool "Lockdep: infer interrupt safety per class"
    default y
    help
      A class seen taken in interrupt context and also taken with
      interrupts on in task context is reported (an interrupt arriving
      while the task holds it, on that CPU, spins forever): Linux's
      hardirq-safe/unsafe inference, one state (AzOS has no softirq).
      Per acquisition: one class-table probe and a flag test. Off, not
      compiled.

config LOCKDEP_SCOPE_CHECKS
    bool "Lockdep: check lock scopes (PerCpu, CpuOwned, Object levels)"
    default y
    help
      Checks the scope types of `azos_sync::scope`: another CPU's
      CpuOwned taken in interrupt context (remote work from an interrupt
      goes through a deferred list), a PerCpu reached with preemption on,
      an Object lock taken under one of an equal or higher level. Per
      scoped access: a hart-id read and two flag tests. Off, not compiled.

config LOCKDEP_RT_CROSS_CPU
    bool "Lockdep: note a sleeping lock contended by RT tasks on two CPUs"
    default y
    help
      Owner rule F7 (until proxy execution): real-time tasks on different
      CPUs should share only a SpinLock. A Mutex whose
      holder and contender are both real-time (base priority below
      RT_PRIORITY_THRESHOLD) on different CPUs is noted. Report-only (owner
      decision 10-10): the note is printed and counted (the ktest summary's
      rt-cross-cpu=), and fails no test. One word per sleeping lock and a
      check on its contended path only. Off, not compiled.
```
