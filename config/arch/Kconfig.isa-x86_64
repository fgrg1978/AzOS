## config/kernel/Kconfig.tasks
```kconfig
# SPDX-License-Identifier: Apache-2.0 OR GPL-2.0-only
# SPDX-FileCopyrightText: 2026 Fernando Rodriguez
# config/kernel/Kconfig.tasks — Kernel tasks: placement, priorities, supervised restarts
#
# A kernel task is pinned by a placement CLASS, never by a CPU number: the
# class is resolved at boot against the CPUs the firmware's CPU map names
# (`nr_cpu_ids`), by azos_percpu::place. tools/lint/task_place_lint.py fails a
# new `task_create_affinity` whose CPU argument is a literal.
#
# The classes (the value of every TASK_*_PLACE below):
#   any      no pin: the scheduler places the task.
#   boot     the boot CPU (logical CPU 0 on every ISA).
#   rt.K     the K-th CPU of the real-time cluster (TASK_RT_CLUSTER_CPUS),
#            the cluster's last CPU when it has fewer; CPU 0 with no cluster.
#   general  the first CPU after the cluster; the last CPU when there is none.
#   last     the last CPU.
# A value that is none of these does not build.
#
# Worked example, the defaults: on 4 CPUs the control loops run on CPU 0,
# the sensor loops on CPU 1, behavior and the watchdog on CPU 2, net-poll
# and autorun on CPU 3; on 2 CPUs, CPU 0 / 1 / 1 / 1; on 1 CPU everything on
# CPU 0; on a K1's 8, CPU 0 / 1 / 2 / 7.

config MM_RECLAIM_PRIORITY
    int "Reclaim task priority (outside the RT band: 12..30)"
    range 12 30
    default 24
    help
      Read only with MM_RECLAIM_COMPRESS. kernel/src/tasks/reclaim.rs,
      `reclaim`: the task that runs the reclaim stages in order when the free
      frames fall below the system low watermark (MM_RECLAIM_HIGH_PCT in use)
      or a Domain with a frame limit crosses its own: the page cache's dirty
      pages are written back and the clean ones dropped, down to
      MM_RECLAIM_LOW_PCT in use; then each Domain over its high watermark has
      its anonymous pages compressed into the pool; and, when a storm ended
      because the pool was full and MM_SWAP_BACKEND is on, a full pool segment
      is written to swap.
      Never real-time (it drops frames under mappings and waits for the disk)
      and pinned to a CPU outside RCU_NOCBS_CPUS and the topology's isolcpus.
      Behind fs-wb (20) so write-back of the volume's cache goes first.

      Cost: none beyond the task (one stack). A smaller number reclaims sooner
      under CPU load.

# ---------------------------------------------------------------------------
# Ring-3 driver supervisor
# ---------------------------------------------------------------------------

config SUP_RESTART_BURST
    int "Supervised driver: restarts allowed within the interval"
    range 1 16
    default 3
    help
      The cold-restart supervisor (kernel/src/drv_supervisor.rs) restarts a
      supervised ring-3 driver that died of a failure (killed by a fault,
      a seccomp kill or a kernel stop request, or exited with a code other
      than 0) at most this many times within SUP_RESTART_INTERVAL_S.  The
      failure after that stays down until the machine restarts.  A driver
      that exits 0 is never restarted.  systemd's StartLimitBurst, with
      Restart=on-failure.

config SUP_RESTART_INTERVAL_S
    int "Supervised driver: restart-limit interval (seconds)"
    range 1 86400
    default 300
    help
      The window SUP_RESTART_BURST counts restarts in: a restart older than
      this no longer counts against the budget, so a driver that fails
      rarely is restarted every time and one in a crash loop is given up
      on.  systemd's StartLimitIntervalSec.  The default leaves the gate's
      four-kill supervisor row (worst case ~80 s under host load) inside
      one window.

# ---------------------------------------------------------------------------
# Driver placement (Phase 4 elasticity)
# ---------------------------------------------------------------------------

config PLACEMENT_PROMOTE_MISSES
    int "Placement: calls over the budget that ask for a move into the kernel"
    range 1 16
    default 4
    help
      A driver whose topology row says stateless = true and declares a
      call_budget_us is moved from ring 3 into the kernel when this many of
      its last 16 calls (measured from the caller, request to reply) took
      longer than the budget, provided the kernel host's measured cost fits
      the budget (azos_topology::placement).  A refused move is recorded as a
      placement decision with the cost the budget would have had to cover.
      One slow call (a cold cache, a preempted server) is not a deadline
      miss; 4 of 16 is.

config PLACEMENT_HOLDOFF_S
    int "Placement: hold-off after a fault in the kernel host (seconds)"
    range 1 86400
    default 300
    help
      After the kernel host of a driver faulted (and the driver restarted in
      ring 3), a move back into the kernel is refused for this long and
      recorded (cause: recent fault).  Without it a driver that faults in the
      kernel and is slow in ring 3 would trade places for ever.

config IORING_WORKER_PRIORITY
    int "io_ring worker task priority (outside the RT band: 12..30)"
    range 12 30
    default 20
    help
      The `ioring-wk` task's priority. It must stay outside the RT band
      (the scheduler's RT threshold is 12): it is the task that may wait on
      the disk on an RT task's behalf. Same default as FS_WRITEBACK_PRIORITY.

      Cost: none. A smaller number completes handed-off entries sooner
      under CPU load.

config FS_WRITEBACK_PRIORITY
    int "FAT32 write-back task priority (outside the RT band: 12..30)"
    range 12 30
    default 20
    help
      kernel/src/boot/sched.rs, `fs-wb`: the task that writes the FAT32
      cache's dirty lines back by age and watermark. Never real-time (owner
      rule: an RT task never does block I/O); below the log flusher (12) so
      durable records go first.

      Cost: none beyond the task. A smaller number writes back sooner under
      CPU load.

config LOG_FLUSHER_PRIORITY
    int "Log flusher task priority (outside the RT band: 12..30)"
    range 12 30
    default 12
    help
      kernel/src/boot/sched.rs, `log-flush`: the kernel task that writes
      the flight recorder's ring to disk and runs the block I/O that
      real-time tasks hand it (owner rule: an RT task never does block
      I/O). Woken by every flush request; an RT task's `*_durable` record
      is on disk once this task has run one flush after the request, so
      its priority is that bound. 12 is the most urgent priority outside
      the RT band (time-sliced, so it cannot starve the band's peers).

      Cost: one kernel task (its stack, KERNEL_STACK_SIZE_KB) on every
      ISA. Lower it (a larger number) only if logging must yield to
      every other normal task.

config KILL_SWITCH_PRIORITY
    int "Kill-switch task priority (real-time band: 1..11)"
    depends on BOARD_IO
    range 1 11
    default 7
    help
      crates/drivers/kill-switch (BOARD_IO), `kill-switch`: the kernel task
      the physical kill switch's GPIO edge interrupt wakes. It samples the
      line and, on a press, latches the e-stop and stops the actuators, so
      the edge-to-stop time is the interrupt handler plus this task's wake.
      7 is above the control loops (8): the latch lands before their next
      tick instead of after it. The task runs only on an edge and every
      KILL_SWITCH_RECHECK_MS, so its share of the band is negligible.

config KILL_SWITCH_RECHECK_MS
    int "Kill-switch re-check period (ms)"
    depends on BOARD_IO
    range 10 1000
    default 500
    help
      How often the kill-switch task samples its line with no edge: a pin
      CONFIG.INI arms after boot is taken up within this, a switch already
      held when the line is armed is a press at the arm, and a board whose
      GPIO interrupt line could not be routed is read only at this period
      (the arm line says "polled"). 500 is the period of the poll it
      replaced (sys-wdt). Lower costs one wake per period.

config TASK_RT_CLUSTER_CPUS
    int "Real-time cluster: CPUs, from the boot CPU up"
    range 0 64
    default 2
    help
      How many CPUs, counted from logical CPU 0, the `rt.K` class spans;
      the `general` class starts at the first CPU after them. A boot with
      fewer CPUs than this has a cluster of all of them.

      The cluster is a placement of the kernel's own tasks only: it does
      not isolate the CPUs (the topology's `[sched] isolcpus` does) and the
      scheduler still places other work on them. It is also the build-time
      real-time CPU set of RCU (RCU_NOCBS_FROM_CLUSTER): no RCU callback,
      thermal or reclaim task runs on it.

      Default 2: the control loops (rt.0) and the sensor loops (rt.1) of
      the robot worked example each have a CPU of their own on a 4-CPU board.

config TASK_NET_POLL_PLACE
    string "net-poll: placement class"
    default "last"
    help
      The network polling task (kernel/src/tasks/net_poll.rs). Default
      `last`: away from the control loops and from behavior. Read only
      with NET.

config AUTORUN
    bool "autorun: load and become CONFIG.INI's `autorun` image at boot"
    # cargo-feature: autorun
    default y
    help
      Kernel feature `autorun`: the boot creates the `autorun` task when
      CONFIG.INI (on the boot volume) names an image with `autorun=<path>`;
      the task loads it and becomes it (kernel/src/tasks/loader.rs).

      The rule: Kconfig decides whether the feature exists, CONFIG.INI only
      whether a boot uses it. With AUTORUN=n the `autorun` key is not read at
      all (a CONFIG.INI that sets it changes nothing) and none of the task's
      code is compiled. The loader itself stays: the driver supervisor's
      successors and the topology's `start = true` rows are loaded by it.

      Cost when set: one task while the image loads (it becomes the program),
      and a 64-byte path buffer. The same on riscv64, aarch64 and x86_64.

config TASK_AUTORUN_PLACE
    string "autorun loader: placement class"
    default "last"
    help
      The task that loads CONFIG.INI's `autorun` image and becomes it
      (kernel/src/tasks/loader.rs), and the CPU a supervised successor of
      that image is created on. Default `last`, beside net-poll: the
      program it becomes serves requests forever and must not compete with
      the control or behavior loops.

config TASK_NET_POLL_PRIORITY
    int "net-poll: priority (0 most urgent .. 31)"
    range 0 31
    default 12
    help
      azos_sched::NET_POLL_PRIORITY; the OTA receiver runs at it too. Default
      12, RT_PRIORITY_THRESHOLD: the most urgent fair priority, so the tick
      still preempts it (below 12 the task is hard real-time and runs until
      it blocks). Read only with NET.

config TASK_AUTORUN_PRIORITY
    int "autorun loader: priority (12 .. 30)"
    range 12 30
    default 16
    help
      The priority the autorun loader runs at, and with it the program it
      becomes and every successor the driver supervisor loads. Outside the
      real-time band on purpose (12 is RT_PRIORITY_THRESHOLD, checked at
      build time): a loader inside it was never preempted by the tick, and
      `net-poll` on its CPU never ran (kernel/src/main.rs, the autorun
      block). Default 16, DEFAULT_PRIORITY.

config TASK_RECOVERY_PRIORITY
    int "recovery console: priority (12 .. 30)"
    range 12 30
    default 13
    help
      The in-kernel recovery console (RECOVERY_CONSOLE). Default 13: above
      the default priority, so it answers while ordinary work runs, below
      net-poll; it parks while a user shell holds the console.

config TASK_IOMMU_FAULTS_PRIORITY
    int "iommu-faults: priority (12 .. 30)"
    range 12 30
    default 13
    help
      The task that drains the IOMMU's fault log every IOMMU_FAULT_POLL_MS
      (only when a unit is up). Default 13.

config TASK_SYS_WDT_PLACE
    string "sys-wdt: placement class"
    default "general"
    help
      The system watchdog task (canaries and timer liveness,
      kernel/src/boot/sched.rs). Default `general`: the first CPU outside
      the real-time cluster, where its only other residents are the behavior
      tasks below it in priority.

config HUNG_DETECT
    bool "Hung task and stuck CPU detector (a step of the sys-wdt pass)"
    default y
    help
      Every sys-wdt pass (500 ms) looks for two things and reports them
      with a warning and a decision record (Rule::Hang) that carries the
      captured state.

      A hung task is one blocked on a wait that names who must end it, for
      HUNG_TASK_TIMEOUT_MS with no context switch in between: a synchronous
      IPC call whose reply has not come, or a wait on a lock or futex whose
      owner is known to the wait graph. A server waiting for
      calls, an idle worker, an event or a ring wait and a timed sleep have
      no owner and are never reported, however long they last.

      A stuck CPU is one that stayed in the kernel for HUNG_CPU_TIMEOUT_MS
      with no kernel entry, exit, idle or context switch (RCU_QSBR's
      per-CPU word moved by none): preemption or interrupts off in a loop,
      or a lock nobody releases. It needs RCU_QSBR and a second CPU, and
      cannot see the CPU the sys-wdt task runs on (the hardware watchdog,
      fed from CPU 0's timer interrupt, is the backstop for CPU 0).

      Off: not compiled; the sys-wdt pass has no extra step. On, the cost
      is the pass's scan of the task table, and nothing on the syscall, IPC
      or context-switch paths: the detector only reads counters those paths
      already keep.

choice
    prompt "Hung task / stuck CPU: action after the report"
    depends on HUNG_DETECT
    default HUNG_ACTION_SAFE_STOP if (USE_ROBOT || USE_INDUSTRIAL) && !BUILD_TYPE_DEV
    default HUNG_ACTION_RESTART if (USE_SERVER || USE_GATEWAY) && !BUILD_TYPE_DEV
    default HUNG_ACTION_NONE
    help
      What the system does besides the warning and the record. Development
      builds only report: under QEMU's wall clock a vCPU the host paused
      looks like a hang.

    config HUNG_ACTION_NONE
        bool "None (warning and record only)"
        help
          Nothing else happens. The record is the only trace a reader of the
          decision journal finds.

    config HUNG_ACTION_RESTART
        bool "Restart the server (stop the task a hung caller waits on)"
        help
          A hung task is stopped on its culprit: the server a call waits for
          or the owner of the lock, when that is a ring-3 task. The kernel
          wakes it out of its wait and ends it (a forced stop) at its next
          syscall or return to user mode, the supervisor respawns it per its
          topology row, and the callers get a peer-died completion. A hung
          task whose culprit is unknown or a kernel task, and a stuck CPU,
          get the warning and the record only.

    config HUNG_ACTION_SAFE_STOP
        bool "Safe stop (latch the e-stop: actuators to their safe state)"
        help
          Any report latches the e-stop (azos_actuation::gate::latch_and_stop):
          the actuators go to their safe state and stay there until an
          operator's signed release. For a machine that must not keep
          moving while part of it does not answer.

endchoice

config HUNG_TASK_TIMEOUT_MS
    int "Hung task: blocked with no switch for this long (ms)"
    depends on HUNG_DETECT
    range 1000 3600000
    default 2000 if (USE_ROBOT || USE_INDUSTRIAL) && !BUILD_TYPE_DEV
    default 30000
    help
      How long a task may sit on a wait with an owner, with no context
      switch, before it is reported (once per hang). The scan runs every
      sys-wdt pass, so the report comes up to one pass (500 ms) later.
      Development builds wait longer for the reason HUNG_ACTION gives. A
      robot or an industrial machine answers within seconds or is stopped.
      No cost: a compare in the sys-wdt pass.

config HUNG_CPU_TIMEOUT_MS
    int "Stuck CPU: in the kernel with no progress for this long (ms)"
    depends on HUNG_DETECT
    range 1000 3600000
    default 2000 if (USE_ROBOT || USE_INDUSTRIAL) && !BUILD_TYPE_DEV
    default 10000
    help
      How long a CPU may run kernel code without one kernel entry, exit,
      idle or context switch before it is reported (once per episode).
      Longer than RCU_STALL_TIMEOUT_MS in a development build, so the RCU
      stall counter (which names the same CPU when a grace period waits
      for it) trips first. No cost: a compare in the sys-wdt pass.

config TASK_OTA_RECV_PLACE
    string "ota-recv: placement class"
    depends on BOOT_SLOTS
    default "general"
    help
      The OTA receiver (CONFIG.INI `ota_auto_recv_port`), created early in
      the boot. Default `general`: outside the real-time cluster.

config TASK_CONTROL_PLACE
    string "Effect loops a driver registers (rt-motor, flight-ctrl): placement class"
    default "rt.0"
    help
      The hard-deadline loops over an effect that an extension's driver
      registers (azos_ext_api::EffectLoop; the robot's motor PID loop and
      flight controller), on one CPU (cache locality: flight-ctrl writes
      what rt-motor reads). Each loop carries its own priority.

config TASK_SENSING_PLACE
    string "Robot sensor loops (imu, sensor-ahrs): placement class"
    default "rt.1"
    help
      The IMU reader and the AHRS fusion, on one CPU, apart from the control
      loops. Read only with USE_ROBOT.
```
