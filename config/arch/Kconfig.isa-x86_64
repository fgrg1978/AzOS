## config/kernel/Kconfig.decisions
```kconfig
# SPDX-License-Identifier: Apache-2.0 OR GPL-2.0-only
# SPDX-FileCopyrightText: 2026 Fernando Rodriguez
# config/kernel/Kconfig.decisions — Decision records (why a request was refused or granted)

config DECISION_RECORDS_DEV
    # cargo-feature: decisions
    bool "Explainable decision records: the ring, every rule"
    default y if KTEST || !HWCLASS_EMBEDDED
    default n
    help
      Boot deadline admission, the real-time band cap, boot memory
      admission, the placement of a woken task on a CPU other than its last
      one, and typed capability denials each write one record naming the
      rule, the verdict, the subject, the numbers the rule compared and the
      alternative it rejected (crates/core/decision). The introspection
      tree's admin region holds the newest DECISION_VIEW_ROWS
      (`decisions/records/<n>`); `why list` prints them.

      On by default in every preset except on a small board
      (HWCLASS_EMBEDDED, whose defconfig names it to have it), and in every
      KTEST kernel (owner, 2026-10-22: the receipts ship on), on the
      condition that the gate row `bench: receipts cost <= 1%`
      (tools/bench/vsbench_cost.sh: the ipc and shell vsbench lanes, this symbol
      off against on, -icount at one hart) holds. Off: every record site
      compiles out. On: a migrating wake pays about 40 instructions and six
      stores (the last is the clock stamp), the admission and denial paths
      the same per record, and the ring costs DECISION_RECORDS_ENTRIES x 48
      bytes of .bss. Maps to the kernel cargo feature `decisions`, a `base`
      tag: emitted unless the symbol is n, so the gate's kernels carry what
      the presets ship.

      This is the development view. The durable receipt of a refusal is
      DECISION_REFUSALS_DURABLE, which does not need this symbol (this one
      was called DECISION_RECORDS before the split).

config DECISION_REFUSALS_DURABLE
    # cargo-feature: decisions-durable
    bool "Explainable decision records: durable receipt of every refusal"
    default y
    help
      Every refusal that goes through crates/core/decision (boot deadline
      and memory admission, the real-time band cap, and the run-time
      SCHED_DEADLINE reservation `rt::reserve` refusing a task) also writes
      one record to the flight recorder, which survives a reset: the rule,
      the subject and the numbers it compared (for a reservation: the
      budget and period asked and the budget the best hart could still
      give). A refusal leaves a receipt whether or not DECISION_RECORDS_DEV
      is on. So does every verdict of the console login (CONSOLE_LOGIN): a
      session admitted is an audit record like an attempt refused.

      The record is queued, not flushed, in a real-time caller: the log
      flusher writes it, as it does every other real-time caller's record
      (an RT task never does block I/O). A refusal raised before the flight
      recorder is armed (boot admission) reaches the console and, when
      DECISION_RECORDS_DEV is on, the ring, and nothing else. Refusals the
      system raises on its own (admission, placement, e-stop, login, a
      reservation) are never rate-limited. The records a ring-3 loop can
      raise once per syscall (a capability denial, an expired deadline, a
      call refused at admission, a refused wait) are written under
      DECISION_DENY_DURABLE_PER_SEC, per Domain and rule; what the limit
      holds back is counted in `refusal-limited` records, never dropped
      without one.

      Cost: nothing on the wake path (the record is conditional on a
      refusal or a denial), and one 20-byte flight-recorder record per
      refusal or admitted denial. Maps to the kernel cargo feature
      `decisions-durable`.

config DECISION_DENY_DURABLE_PER_SEC
    int "Explainable decision records: durable caller-paced records per second, per Domain and rule"
    range 0 1000
    default 4
    help
      A record a task can raise once per syscall (rules `cap-denial`,
      `deadline-expired`, `call-admission`, `wait-cycle`) also writes a
      flight-recorder record, through a token bucket per Domain and rule: this
      many records per second refill the bucket, DECISION_DENY_DURABLE_BURST
      is its depth. The threads of one process share their Domain's bucket.
      The bucket table is small and fixed; when it is full a new Domain takes
      the bucket of the one that has been held back the most, so a quiet
      Domain keeps its first records however many Domains flood, and the
      flooder is what loses its history.

      What the bucket holds back is never silent. The first record held back
      in a run writes a `refusal-limited` record (Domain, rule, count 1); the
      rest are counted into the one the pair's next record, a quieter
      Domain's eviction of its bucket, or a second of quiet from the pair
      writes (the log flusher runs the check), so the counts add up to the
      records held back. A denial's own third number (`dropped`) also carries
      its count. The total is the introspection tree's
      `decisions/deny_dropped`. 0 writes no durable record of these rules
      (they are only counted); the refusals the system raises are not
      affected.

config DECISION_DENY_DURABLE_BURST
    int "Explainable decision records: durable caller-paced records, burst"
    range 1 64
    default 8
    help
      Depth of the per-Domain, per-rule bucket of
      DECISION_DENY_DURABLE_PER_SEC: how many records a Domain may leave back
      to back, from a full bucket.

config DECISION_RECORDS_CONSOLE
    # cargo-feature: decisions-console
    bool "Print every decision record on the console"
    depends on DECISION_RECORDS_DEV
    default n
    help
      A kernel task follows the decision ring and prints one line per record,
      `[DECISION] <rule> <verdict> subject=<n> n=<a>,<b>,<c>`, and how many the
      ring overwrote before it got there. For a machine with a console and no
      `why` to ask, and for the gate rows that hold the verdicts of a boot to
      account (reclaim's). Off in every preset.

      Cost: one task, a wake every 50 ms, and the console time of the lines.

config DECISION_RECORDS_ENTRIES
    int "Explainable decision records: ring depth"
    range 8 4096
    default 16 if HWCLASS_EMBEDDED
    default 256 if HWCLASS_SERVER
    default 64
    help
      Records kept; the oldest is overwritten. 48 bytes each. Raise it when
      migrating wakes evict the boot admission records you want to read;
      read only when DECISION_RECORDS_DEV is on.

config DECISION_JOURNAL_ENTRIES
    int "Explainable decision records: durable journal depth"
    range 8 4096
    default 16 if HWCLASS_EMBEDDED
    default 128 if HWCLASS_SERVER
    default 32
    help
      Decisions kept whole in RAM after they went down the durable path (a
      refusal, a rate-limited capability denial): the rule, verdict, subject,
      numbers, clock and every provenance field (crates/core/decision,
      `journal`). The flight recorder keeps a 20-byte receipt on the medium;
      this is what `why <id>` (the recovery console, the Decisions
      interface) and the decision query read it back from, with the ring off.
      The oldest durable record is overwritten, however many records the
      ring (DECISION_RECORDS_DEV) keeps in between. 112 bytes each of .bss,
      only with DECISION_REFUSALS_DURABLE. A storm of caller-paced records (bounded by
      DECISION_DENY_DURABLE_PER_SEC per Domain and rule) can push an old
      refusal out of a small journal; the receipt on the medium is not
      affected.

config DECISION_VIEW_ROWS
    int "Explainable decision records: records the admin view publishes"
    range 8 48
    default 24
    help
      Decision records the kernel publishes in the introspection tree's
      admin region (`decisions/records/<n>`, kernel/src/boot/inspect_views.rs)
      and the decision server (userspace/services/decisd) decodes and serves
      to `why`: one number for both sides (azos_decision::VIEW_ROWS). With the
      ring and the durable path both built, the durable records keep half of
      them. Read only with DECISION_RECORDS_DEV or DECISION_REFUSALS_DURABLE.

      Each costs 104 bytes in the admin region (the range keeps the admin
      tree inside the default INSPECT_ADMIN_PAGES, tests/host/inspect-tests)
      and 208 bytes of decisd's memory (its table and the copy it reads
      into; its frame budget follows this number). Raise it to keep more
      decisions listable from ring 3; `why <id>` in the recovery console and
      the kernel's query read the ring and the journal, not this view.
```
